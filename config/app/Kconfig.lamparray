## config/boards/helloword/hw75_dynamic/Kconfig.hw75_dynamic
```kconfig
# HW-75 board configuration

# Copyright (c) 2022-2023 XiNGRZ
# SPDX-License-Identifier: MIT

config BOARD_HW75_DYNAMIC
	select SOC_STM32F405XG
```

## config/boards/helloword/hw75_dynamic/app/Kconfig.eink
```kconfig
# Copyright (c) 2023 XiNGRZ
# SPDX-License-Identifier: MIT

config HW75_EINK
	bool "HW-75 e-ink application"
	default y
	help
	  Enable the HW-75 e-ink preference/demo companion application.
```

## config/boards/helloword/hw75_dynamic/app/Kconfig.knob
```kconfig
# Copyright (c) 2023 XiNGRZ
# SPDX-License-Identifier: MIT

config HW75_KNOB
	bool "HW-75 knob application"
	default y
	help
	  Enable the HW-75 knob preference/demo companion application.
```

## config/boards/helloword/hw75_dynamic/board.yml
```yaml
# Copyright (c) 2022-2023 XiNGRZ
# SPDX-License-Identifier: MIT

board:
  name: hw75_dynamic
  vendor: helloword
  revision:
    format: letter
    default: A
    exact: false
    revisions:
      - name: A
      - name: B
  socs:
    - name: stm32f405xg
```

## config/boards/helloword/hw75_keyboard/Kconfig.hw75_keyboard
```kconfig
# HW-75 board configuration

# Copyright (c) 2022-2023 XiNGRZ
# SPDX-License-Identifier: MIT

config BOARD_HW75_KEYBOARD
	select SOC_STM32F103XB
	select ZMK_BOARD_COMPAT if BOARD_HW75_KEYBOARD_STM32F103XB_ZMK
```

## config/boards/helloword/hw75_keyboard/app/uart_comm/Kconfig
```kconfig
# Copyright (c) 2022-2023 XiNGRZ
# SPDX-License-Identifier: MIT

config HW75_UART_COMM
	bool "HW-75 UART companion link (SLIP)"
	depends on SERIAL
	select HW75_PROTO_UART_COMM
	help
	  Enable the UART-based companion link used to talk to the host
	  configuration tool over a SLIP-attached UART. Off by default in
	  this ZMK 4.x build; enable explicitly if your board's keymap or
	  companion tooling requires it.
```

## config/boards/helloword/hw75_keyboard/board.yml
```yaml
# Copyright (c) 2022-2023 XiNGRZ
# SPDX-License-Identifier: MIT

board:
  name: hw75_keyboard
  vendor: helloword
  revision:
    format: major.minor.patch
    default: 1.1.0
    exact: false
    revisions:
      - name: 1.1.0
      - name: 1.2.0
  socs:
    - name: stm32f103xb
      variants:
        - name: zmk
```
